/**
 * @file     
 * @version  V1.0.0
 * @author   Leo.Li
 * @date     2024-7-15
 * @brief    该文件包含了...
 * 
 * @copyright Copyright (C) 2011-2022 Fortior Technology Co., Ltd. All rights reserved.

/********************************************************************************
    Header Definition
********************************************************************************/
#include <MyProject.h>

/**
 * @brief        CMP012初始化
 * @date         2022-09-13
 */
void CMP012_Init(void)
{
    /*  -------------------------------------------------------------------------------------------------
    CMP_CR0
    [7:6]  CMP3IM CMP3 中断模式  00-不产生中断 01-上升沿产生中断 10-下降沿产生中断 11-逐波限流
    [5:4]  CMP2IM 同CMP0
    [3:2]  CMP1IM 同CMP0
    [1:0]  CMP0IM CMP0 中断模式  00-不产生中断 01-上升沿产生中断 10-下降沿产生中断 11-上升下降均产生中断

    -------------------------------------------------------------------------------------------------*/
//		if(mcState == mcStart)
//		{
//			ClrBit(CMP_CR0, CMP2IM1);
//			ClrBit(CMP_CR0, CMP2IM0);

//			ClrBit(CMP_CR0, CMP1IM1);
//			ClrBit(CMP_CR0, CMP1IM0);

//			ClrBit(CMP_CR0, CMP0IM1);
//			ClrBit(CMP_CR0, CMP0IM0);
//		}
    /*均不均产生中断，注意：使能中断后一定要有对应的中断函数，否则程序会跑飞*/

    /*  -------------------------------------------------------------------------------------------------
    CMP_CR1
    [7]    RSV
    [6:5]  CMP3MOD CMP3的模式选择  00-单比较器  01-双比较器  1X-3比较器
    [4]    CMP3EN  CMP3使能
    [3]    CMP3HYS CMP3的迟滞电压
    [2]    RSV
    [1：0] CMP0HYS CMP0/1/2的迟滞电压
    -------------------------------------------------------------------------------------------------*/
    SetBit(CMP_CR1, CMP0HYS1);
    SetBit(CMP_CR1, CMP0HYS0);

    /*  -------------------------------------------------------------------------------------------------
    CMP_CR2
    [7]    CMP4EN
    [6:5]  CMP0MOD CMP0/1/2的模式设置
    [4:3]  CMP0SEL CMP0/1/2的端口组合选择，与CMP_CR2[CMP0MOD]组合使用
    [2:1]  RSV
    [0]    CMP0EN
    -------------------------------------------------------------------------------------------------*/
    ClrBit(CMP_CR2, CMP0MOD); // 0：三比较器模式 1：双比较器（顺逆风）
	
    ClrBit(CMP_CR2, CMP0SEL1);
    ClrBit(CMP_CR2, CMP0SEL0);//CMP0、CMP1和CMP2三比较器同时工作

    /*内置虚拟中性点设置*/

    /*  -------------------------------------------------------------------------------------------------
    CMP_CR3
    [7]    RSV  
    [6:5]  DBGSEL   输出Debug 信号选择，输出到P1.5 端口
    [4:3]  SAMSEL   CMP0、CMP1、CMP2 和ADC 在PWM ON/OFF 采样延迟使能
                        00-在ON 和OFF 均采样，无延迟采样
                        01-只在OFF 采样，根据 CMP_SAMR 延迟采样
                        10-只在ON 采样，根据 CMP_SAMR 延迟采样
                        11-在ON 和OFF 均采样，根据 CMP_SAMR 延迟采样
    [2:0]  CMPSEL   比较器输出选择，输出到P0.7 端口
    -------------------------------------------------------------------------------------------------*/

	if(mcState == mcStart)
	{
		ClrBit(CMP_CR3, SAMSEL1); /*OFF时比较器采样*/
		ClrBit(CMP_CR3, SAMSEL0);
	}		
    /*  -------------------------------------------------------------------------------------------------
    CMP_CR4
    [7]   CMP4OUT    CMP4 比较结果
    [6:5] RSV
    [4]   CMP3P4M_FS CMP3P 与CMP4M 功能转移至P3.4
    [3]   RSV
    [2]   FAEN       滤波采样系数扩大使能
    [1]   CMP0FS     CMP1/CMP2 功能转移
    [0]   RSV
    -------------------------------------------------------------------------------------------------*/
    ClrBit(CMP_CR4, FAEN);
    //	SetBit(CMP_CR4 , CMP0_FS);  //滤波采样系数扩大使能
    /*比较器输入信号转移 P1.3 P1.4 P1.5作为电机的输入*/

    /*  -------------------------------------------------------------------------------------------------
    CMP_SAMR
    采样屏蔽区间设置
    -------------------------------------------------------------------------------------------------*/
    //CMP_SAMOFF = 0x33;
	CMP_SAMON  = 0x02;
	CMP_SAMOFF = 0x02 | 0x80;	

    ///*  -------------------------------------------------------------------------------------------------
    // CMP_SR
    // 采样屏蔽区间设置
    //-------------------------------------------------------------------------------------------------*/
    CMP_SR = 0x00;

    /*  -------------------------------------------------------------------------------------------------
    HALL_CR
    采样屏蔽区间设置
    -------------------------------------------------------------------------------------------------*/
    HALL_CR = 0x00;

    /*  -------------------------------------------------------------------------------------------------
    使能比较器012
    -------------------------------------------------------------------------------------------------*/
    SetBit(CMP_CR2, CMP0EN);
}

/**
 * @brief        比较器3初始化
 * @date         2024-07-14
 */
void CMP3_Init(void)
{
    uint16 overcurrentvalue;
	#if (COMPARE_MODE == COMPARE_HW_MODE)
    {
        /**P2.6使能其模拟功能，使能数字输出**/
        SetBit(P1_AN , P14);
        ClrBit(P1_OE , P14); 
        ClrBit(ADC_SCYC1 , DAC0_1EN);
    }
    #else
    {  		
		SetBit(ADC_SCYC1 , DAC0_1EN);        
		 /******************************
        0: 正常模式，DAC输出电压范围为0到VREF
        1: 半电压转换模式，DAC输出电压范围为VHALF到VREF
        ****************************/
        ClrBit(ADC_SCYC1 , DACMOD);
		
		// DAC0_DR 是DAC0的高8位,DAC0 的最低位忽略
        overcurrentvalue = DAC_OverCurrentValue;	
		if(overcurrentvalue >= 255)
			DAC0_DR = 255;		
		else
			DAC0_DR = overcurrentvalue;	
	}
	#endif

	SetBit(CMP_CR1, CMP3MOD); //接入运放输出
	
    SetBit(CMP_CR1, CMP3HYS); // CMP3的迟滞电压选择 10mv
	
	 /*---------------------------------------------------------------------------------
	选择母线电流保护触发信号源，外部中断0或者比较器3中断。
	0-CMP3,1-INT0
    ---------------------------------------------------------------------------------*/
    ClrBit(EVT_FILT, INT0_MOE_EN);
    	
    /*---------------------------------------------------------------------------------
    触发硬件保护后硬件关闭驱动输出MOE配置， 常规应用需要使能MOE自动清零
    00--MOE不自动清零
    01--MOE自动清0
    10--MOE自动清0，且在Driver计数器的上溢下溢事件或10μs后自动使能MOE(用于方波驱动)
    11--MOE自动清0，且在Driver计数器的上溢下溢事件或5μs后自动使能MOE(用于方波驱动)
    ----------------------------------------------------------------------------------*/
    ClrBit(EVT_FILT, MOEMD1); // 
    SetBit(EVT_FILT, MOEMD0);

    // SetBit(CMP_CR0,CMP3IM1);//11:打开逐波限流
    // SetBit(CMP_CR0,CMP3IM0);//11:CMP过流信号
	
	SetBit(EVT_FILT, OFF_MOEH_EN); // 
    SetBit(EVT_FILT, OFF_MOEL_EN);

    /*----------------------------------------------------------------------------------
    母线电流保护时间滤波宽度
    00-不滤波
    01-4cpu clock
    10-8cpu clock
    11-16cpu clock
    -----------------------------------------------------------------------------------*/
    ClrBit(EVT_FILT, EFDIV1);
    SetBit(EVT_FILT, EFDIV0);
	
	SetBit(CMP_CR1 , CMP3EN);   //CMP3 Enable	
}

/**
 * @brief        CMP3中断初始化
 * @date         2024-07-14
 */
void CMP3_Interrupt_Init(void)
{
    ClrBit(CMP_SR, CMP3IF);
    /*------------------------------------------------------------------------
    比较器中断模式配置
    00: 不产生中断
    01: 上升沿产生中断
    10: 下降沿产生中断
    11: 
    ------------------------------------------------------------------------*/
    ClrBit(CMP_CR0, CMP3IM1);
    SetBit(CMP_CR0, CMP3IM0);
    SetBit(IP3, PCMP31); // 中断优先级别3
    SetBit(IP3, PCMP30);
}

/**
 * @brief        比较器4硬件过流配置
 * @date         20251015
 */
void CMP4_OverCurrent_Init(void)
{
	static uint16 OverflowValue =0; 
    /*按照手册顺序配置，同比较器3相同的配置注释*/
    /*CMP正输入端*/
//    SetBit(ADC_SCYC1,DAC0_1EN);//DAC0,DAC1使能位
//    ClrBit(ADC_SCYC1,DACMOD);//0:全电压输出  1：半电压输出
	
	if(OverflowValue > 127)
		DAC1_DR = 127;
	else
		DAC1_DR = DAC_OverCurrentValue;//单端采用实际偏置
    /*CMP负输入端*/
//    SetBit(CMP_CR1,CMP3MOD);/*6561只能AP0O做正端输入*/

    SetBit(CMP_CR2,CMP4EN);//CMP4使能
    /*CMP*/  

    ClrBit(INT_SR4,IF0);//清零外部中断标志位
		 /*---------------------------------------------------------------------------------
	INT0_MOE_EN : INT0 中断触发DRV_OUT[MOEH]/DRV_OUT[MOEL]关闭使能 
	0: 不使能 
	1: 使能
    ---------------------------------------------------------------------------------*/
    SetBit(EVT_FILT, INT0_MOE_EN);
    EX0 = 1;//外部中断INT0使能位
    SetReg(LVSR, EXT0CFG0|EXT0CFG1|EXT0CFG2 , EXT0CFG0|EXT0CFG1|EXT0CFG2);//111:CMP4为外部中断源
    IT00 = 1;//01:下降沿触发
    IT01 = 0;//01:下降沿触发
    SetBit(IP0,PX01);//最高优先级
    SetBit(IP0,PX00);//最高优先级
}

